## iot_firmware/components/m5stickc_plus/Kconfig
```kconfig
menu "m5stick_c+"
  config M5STICKC_PLUS_I2C
    prompt "Port A Configuration"
    help
      Port A configuration
    config M5STICKC_PLUS_I2C_ENABLE
      bool "Enable I2C"
      default n

choice M5STICKC_PLUS_I2C_NUM
    prompt "I2C instance"
    depends on M5STICKC_PLUS_I2C_ENABLE
    default M5STICKC_PLUS_I2C_NUM_0
    config M5STICKC_PLUS_I2C_NUM_0
      bool "I2C_NUM_0"
    config M5STICKC_PLUS_I2C_NUM_1
      bool "I2C_NUM_1"
  endchoice

choice M5STICKC_PLUS_I2C_MODE
    prompt "I2C Mode"
    depends on M5STICKC_PLUS_I2C_ENABLE
    default M5STICKC_PLUS_I2C_MASTER
    config M5STICKC_PLUS_I2C_MASTER
      bool "master mode"
    config M5STICKC_PLuS_I2C_SLAVE
      bool "slave mode"
  endchoice
    
  config M5STICKC_PLUS_I2C_CLK
    help
      I2C Baudrate
    int "Baudrate of i2c on port A"
    depends on M5STICKC_PLUS_I2C_ENABLE
    default 400000
  config M5STICKC_PLUS_I2C_TIMEOUT
    help
      I2C timeout
    int "Timeout for i2c on port A"
    depends on M5STICKC_PLUS_I2C_ENABLE
    default 400000
  config M5STICKC_PLUS_I2C_PULLUP_ENABLE
    bool "pullup register enabled"
    depends on M5STICKC_PLUS_I2C_ENABLE
    default y
endmenu
```

## iot_firmware/components/wificlient/test/Kconfig
```kconfig
menu WIFICLIENT_TEST
  config WIFICLIENT_TEST_SSID
    string "ssid"
    default ""

  config WIFICLIENT_TEST_PASSWORD
    string "password"
    default ""
endmenu
```

## iot_firmware/main/Kconfig
```kconfig
menu "be_BONSAI"
  config AWS_IOT_CLIENT_ID
    string "AWS IoT Client ID"
    default "testThing"
    help
      AWS IoT Client ID. Should be unique for every device.

  config AWS_IOT_THING_NAME
    string "AWS IoT Thing Name"
    default "testThing"
    help
      AWS IoT Thing Name. Should be unique for every device.

  choice PRODUCT_TYPE
    prompt "Product Type"
    default M5STACK_CORE2
    config M5STACK_CORE2
      bool "Core 2"
    config M5STICK_C_PLUS
      bool "C_Plus"
  endchoice

  choice PORT_A
    prompt "PORT_A configuration"
    default PORT_A_I2C
    help
      PORT_A configuration.
    config PORT_A_EARTH_UNIT
      bool "PORT_A_EARTH_UNIT"
    config PORT_A_I2C
      bool "PORT_A_I2C"
    config I2C_BAUDRATE
      int "Baudrate of i2c on port A"
      depends on PORT_A_I2C
      default 400000
    config I2C_TIMEOUT
      int "Timeout of i2c on port A"
      depends on PORT_A_I2C
      default 400000
    config I2C_PULLUP_ENABLE
      bool "pullup register enabled"
      depends on PORT_A_I2C
      default y
    config I2C_SHT30
      bool "has a connection to SHT30 (TODO)"
      depends on PORT_A_I2C
      default n
    config I2C_PORT_A_HAS_PAHUB
      bool "has a connection to PAHUB"
      depends on PORT_A_I2C
      default n
    config I2C_PORT_A_HAS_PBHUB
      bool "has a connection to PBHUB"
      depends on PORT_A_I2C && I2C_PORT_A_HAS_PAHUB
      default n
    config I2C_SHT30_FOR_ENV_ON_CH0_ON_PAHUB_ON_PORT_A
      bool "has sht30 temperature & humodity sensor on CH0 on PAHUB. It's used for environment."
      depends on PORT_A_I2C && I2C_PORT_A_HAS_PAHUB
      default n
    config I2C_SHT30_FOR_SOIL_ON_CH1_ON_PAHUB_ON_PORT_A
      bool "has sht30 temperature & humodity sensor on CH1 on PAHUB. It's used for soil. (EXPERIMENTAL)"
      depends on I2C_PORT_A_HAS_PAHUB
      default n
    config I2C_PORT_A_HAS_LIGHTSENSOR_VIA_CH0_ON_PBHUB
      bool "has lightsensor on CH0 on PBHUB"
      depends on PORT_A_I2C && I2C_PORT_A_HAS_PBHUB
      default n
    config I2C_PORT_A_HAS_EARTH_SENSOR_VIA_CH1_ON_PBHUB
      bool "has earth_sensor on CH1 on PBHUB"
      depends on PORT_A_I2C && I2C_PORT_A_HAS_PBHUB
      default n
  endchoice
  choice SLEEP_TYPE
    prompt "Sleep type of ESP32"
    default SLEEP_TYPE_LIGHT
    config SLEEP_TYPE_LIGHT
      bool "Light sleep"
    config SLEEP_TYPE_DEEP
      bool "Deep sleep"
  endchoice
  config SLEEP_TIMER_TIMEOUT
      int "Timeout[us] of timer for wakeup interruption. default 10 min"
      default 600000000

  config WEIGHT_SCALE_PER_BIT
      string "float value of weight scale per bit"
      default "0.001"

endmenu


menu "PowerSave Configuration"
  config EXAMPLE_WIFI_LISTEN_INTERVAL
      int "WiFi listen interval"
      default 3
      help
          Interval for station to listen to beacon from AP. The unit of listen interval is one beacon interval.
          For example, if beacon interval is 100 ms and listen interval is 3, the interval for station to listen
          to beacon is 300 ms.

  choice EXAMPLE_POWER_SAVE_MODE
      prompt "power save mode"
      default EXAMPLE_POWER_SAVE_MIN_MODEM
      help
          Power save mode for the esp32 to use. Modem sleep mode includes minimum and maximum power save modes.
          In minimum power save mode, station wakes up every DTIM to receive beacon. Broadcast data will not be
          lost because it is transmitted after DTIM. However, it can not save much more power if DTIM is short
          for DTIM is determined by AP.
          In maximum power save mode, station wakes up every listen interval to receive beacon. Broadcast data
          may be lost because station may be in sleep state at DTIM time. If listen interval is longer, more power
          is saved but broadcast data is more easy to lose.

      config EXAMPLE_POWER_SAVE_NONE
          bool "none"
      config EXAMPLE_POWER_SAVE_MIN_MODEM
          bool "minimum modem"
      config EXAMPLE_POWER_SAVE_MAX_MODEM
          bool "maximum modem"
  endchoice

  choice EXAMPLE_MAX_CPU_FREQ
      prompt "Maximum CPU frequency"
      default EXAMPLE_MAX_CPU_FREQ_80
      depends on PM_ENABLE
      help
          Maximum CPU frequency to use for dynamic frequency scaling.

      config EXAMPLE_MAX_CPU_FREQ_80
          bool "80 MHz"
      config EXAMPLE_MAX_CPU_FREQ_160
          bool "160 MHz"
      config EXAMPLE_MAX_CPU_FREQ_240
          bool "240 MHz"
          depends on IDF_TARGET_ESP32 || IDF_TARGET_ESP32S2 || IDF_TARGET_ESP32S3
  endchoice

  config EXAMPLE_MAX_CPU_FREQ_MHZ
      int
      default 80 if EXAMPLE_MAX_CPU_FREQ_80
      default 160 if EXAMPLE_MAX_CPU_FREQ_160
      default 240 if EXAMPLE_MAX_CPU_FREQ_240


  choice EXAMPLE_MIN_CPU_FREQ
      prompt "Minimum CPU frequency"
      default EXAMPLE_MIN_CPU_FREQ_10M
      depends on PM_ENABLE
      help
          Minimum CPU frequency to use for dynamic frequency scaling.
          Should be set to XTAL frequency or XTAL frequency divided by integer.

      config EXAMPLE_MIN_CPU_FREQ_40M
          bool "40 MHz (use with 40MHz XTAL)"
          depends on !IDF_TARGET_ESP32 || ESP32_XTAL_FREQ_40 || ESP32_XTAL_FREQ_AUTO
      config EXAMPLE_MIN_CPU_FREQ_20M
          bool "20 MHz (use with 40MHz XTAL)"
          depends on !IDF_TARGET_ESP32 || ESP32_XTAL_FREQ_40 || ESP32_XTAL_FREQ_AUTO
      config EXAMPLE_MIN_CPU_FREQ_10M
          bool "10 MHz (use with 40MHz XTAL)"
          depends on !IDF_TARGET_ESP32 || ESP32_XTAL_FREQ_40 || ESP32_XTAL_FREQ_AUTO
      config EXAMPLE_MIN_CPU_FREQ_26M
          bool "26 MHz (use with 26MHz XTAL)"
          depends on ESP32_XTAL_FREQ_26 || ESP32_XTAL_FREQ_AUTO
      config EXAMPLE_MIN_CPU_FREQ_13M
          bool "13 MHz (use with 26MHz XTAL)"
          depends on ESP32_XTAL_FREQ_26 || ESP32_XTAL_FREQ_AUTO
  endchoice

  config EXAMPLE_MIN_CPU_FREQ_MHZ
      int
      default 40 if EXAMPLE_MIN_CPU_FREQ_40M
      default 20 if EXAMPLE_MIN_CPU_FREQ_20M
      default 10 if EXAMPLE_MIN_CPU_FREQ_10M
      default 26 if EXAMPLE_MIN_CPU_FREQ_26M
      default 13 if EXAMPLE_MIN_CPU_FREQ_13M

endmenu
```
